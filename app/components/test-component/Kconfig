## app/components/test-component/Kconfig
```kconfig
menu "Abiots Test component"
    
    config ABIOTS_INCLUDE_THIS
        string "AbIots include this component in the project"
        default ""
        help
            Default will include this in the project.

endmenu # ABiots Test Component
```
